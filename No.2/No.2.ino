#include <stdio.h> 
#include <stdlib.h>

#define ROUND_NUM 100 
typedef unsigned char u8;
  
u8 sbox2[256] = { 0x63, 0x7c, 0x77, 0x7b, 0xf2, 0x6b, 0x6f, 0xc5, 0x30, 0x01, 0x67, 0x2b, 0xfe, 0xd7,
  0xab, 0x76, 0xca, 0x82, 0xc9, 0x7d, 0xfa, 0x59, 0x47, 0xf0, 0xad, 0xd4, 0xa2, 0xaf,
  0x9c, 0xa4, 0x72, 0xc0, 0xb7, 0xfd, 0x93, 0x26, 0x36, 0x3f, 0xf7, 0xcc, 0x34, 0xa5,
  0xe5, 0xf1, 0x71, 0xd8, 0x31, 0x15, 0x04, 0xc7, 0x23, 0xc3, 0x18, 0x96, 0x05, 0x9a,
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  0xb0, 0x54, 0xbb, 0x16 };

u8 sbox3[256] = { 0x9c, 0x83, 0x88, 0x84, 0x0d, 0x94, 0x90, 0x3a, 0xcf, 0xfe, 0x98, 0xd4, 0x01, 0x28, 0x54, 0x89,
  0x35, 0x7d, 0x36, 0x82, 0x05, 0xa6, 0xb8, 0x0f, 0x52, 0x2b, 0x5d, 0x50, 0x63, 0x5b, 0x8d, 0x3f,
  0x48, 0x02, 0x6c, 0xd9, 0xc9, 0xc0, 0x08, 0x33, 0xcb, 0x5a, 0x1a, 0x0e, 0x8e, 0x27, 0xce, 0xea,
  0xfb, 0x38, 0xdc, 0x3c, 0xe7, 0x69, 0xfa, 0x65, 0xf8, 0xed, 0x7f, 0x1d, 0x14, 0xd8, 0x4d, 0x8a,
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  0x73, 0x5e, 0x76, 0xf2, 0x40, 0x19, 0xbd, 0x97, 0xbe, 0x66, 0xd2, 0xf0, 0x4f, 0xab, 0x44, 0xe9 };

void key_gen(u8* rnd, u8* key) { 
  u8 key1 = ~key[0]; 
  u8 key2 = ~key[1]; 
  u8 A, B;

  A = key1 + key2;
  rnd[0] = (key1 | key2) + 0xff;
  rnd[1] = A - rnd[0];

  B = ~rnd[0] + ~rnd[1];
  key2 = ~(rnd[0] & rnd[1]) + 0xfe;
  key1 = B - key2;

  rnd[2] = key1;
  rnd[3] = key2;

  int i, j = 4, k=0xfd;
  for (i = 2; i < ROUND_NUM; i=i+2) {
    key1 = ~(key1 & key2) + (k--); 
    key2 = A - key1;

    rnd[j++] = key1; 
    rnd[j++] = key2;

    key2 = ~(key1 & key2) + (k--); 
    key1 = B - key2;
  
    rnd[j++] = key1; 
    rnd[j++] = key2;
  }
}

void enc(u8* text, u8* rnd) { 
  u8 text1 = ~text[0]; 
  u8 text2 = ~text[1]; 
  u8 tmp1, tmp2;

  // 0 ROUND
  tmp1 = ((text1 + text2) ^ text1) - rnd[0];
  tmp2 = (-text1) ^ rnd[1];
  
  int i, j = 2; 
  for (i = 1; i < ROUND_NUM - 1; i = i + 2) { 
    text1 = tmp1; 
    text2 = sbox3[tmp2];

    tmp1 = ((text1 + text2) ^ text2) - rnd[j++]; 
    tmp2 = (-text2) ^ rnd[j++];
  
    text1 = tmp1; 
    text2 = sbox3[tmp2];

    tmp1 = ((text1 + text2) ^ text1) - rnd[j++]; 
    tmp2 = (-text1) ^ rnd[j++];
   
  } 
  
  // 99 ROUND
  text1 = tmp1;
  text2 = sbox3[tmp2];
  
  tmp1 = ((text1 + text2) ^ text2) - rnd[198];
  tmp2 = (-text2) ^ rnd[199];
  
  text[0] = ~tmp1;
  text[1] = sbox2[tmp2];
 
}


void testVector(){
  u8 key[2] = { 0x12, 0x34 }; 
  u8 rnd[ROUND_NUM * 2] = { 0, }; 
  u8 text[2] = { 0x56, 0x78 };

  Serial.print("plain text : ");Serial.print(text[0],HEX);Serial.print(text[1],HEX);
  key_gen(rnd, key);
  enc(text, rnd); 
  Serial.print("\ncipher text : ");Serial.print(text[0],HEX);Serial.println(text[1],HEX);
  
}


void loop(){
}

void setup(){
  Serial.begin(9600);

  u8 key[2] = { 0x12, 0x34 };   
  u8 rnd[ROUND_NUM * 2] = { 0, }; 
  u8 text[2] = { 0x56, 0x78 };

  u32 time1; 
  u32 time2;

  //테스트벡터 확인
  testVector();

  //벤치마크
  time1 = millis(); 
  for (int i = 0; i < 10000; i++) { 
    key_gen(rnd, key);
    enc(text, rnd); 
  }  
  time2 = millis();
  Serial.println((time2 - time1));
}
